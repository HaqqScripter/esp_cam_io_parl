## Kconfig
```kconfig
menu "Parallel IO Camera configuration"

    config ESP_CAM_IO_PARL_NT99141
        bool "Support NT99141 HD"
        depends on (SOC_PARLIO_RX_UNIT_MAX_DATA_WIDTH > 8)
        default y
        help
            Enable this option if you want to use the NT99141.
            Disable this option to save memory.

    config ESP_CAM_IO_PARL_OV2640
        bool "Support OV2640 2MP"
        depends on (SOC_PARLIO_RX_UNIT_MAX_DATA_WIDTH > 8)
        default y
        help
            Enable this option if you want to use the OV2640.
            Disable this option to save memory.

    config ESP_CAM_IO_PARL_OV3660
        bool "Support OV3660 3MP"
        default y
        help
            Enable this option if you want to use the OV3660.
            Disable this option to save memory.

    menuconfig ESP_CAM_IO_PARL_OV5640
        bool "Support OV5640 5MP"
        default y
        help
            Enable this option if you want to use the OV5640.
            Disable this option to save memory.

    if ESP_CAM_IO_PARL_OV5640
        config ESP_CAM_IO_PARL_OV5640_AF
            bool "Enable autofocus function"
            help
                Enable this option if you want to use the autofocus feature on OV5640.
                Disable this option to save memory and faster initialization time.

        choice ESP_CAM_IO_PARL_OV5640_HPM
            bool "High Performance Mode (24MHz XCLK recommended)"
            default ESP_CAM_IO_PARL_OV5640_HPM_DIS
            help
                Whether the High Performance Mode of OV5640 is enabled.
                Enabling this option allows high frame rate captures by modifying the PLL registers.
                For example, this option allows 20fps at 2560x1440 and 15fps at maximum resolution.
                User can set this mode at any resolution, or resolutions above 1280x960.
                If disabled, default OV5640 settings will be used instead.

            config ESP_CAM_IO_PARL_OV5640_HPM_ANY_RES
                bool "Any resolution"
            config ESP_CAM_IO_PARL_OV5640_HPM_HIGH_RES
                bool "Resolutions above 1280x960"
            config ESP_CAM_IO_PARL_OV5640_HPM_DIS
                bool "Disabled"
        endchoice

    endif

    menuconfig ESP_CAM_IO_PARL_FRAME_SIZE_AUTO
        bool "Automatically set frame buffer size on resolution change"
        default y
        help
            Enable this option if you want to automatically set the frame allocation size without setting it manually.
            For RAW image format, the frame buffer size is simply (width * height * bpp) where bpp is bytes per pixel and it depends on the raw image format used. For example, RGB565 has bpp set to 2 indicating two bytes per pixel.
            For JPEG image format, user can determine the JPEG buffer size dynamically (bytes) with the formula (width * height * multiplier / divider + padding)

    if ESP_CAM_IO_PARL_FRAME_SIZE_AUTO
        comment "For JPEG format, the size is calculated by the formula: (width * height * multiplier / divider + padding)"

        config ESP_CAM_IO_PARL_FRAME_SIZE_MUL
            int "JPEG frame buffer multiplier"
            range 0 100
            default 2
            help
                Determines the multiplier of the frame buffer size, this can be used to achieve precise value if paired with the divider.

        config ESP_CAM_IO_PARL_FRAME_SIZE_DIV
            int "JPEG frame buffer divider"
            range 1 100
            default 9
            help
                Determines the divider of the frame buffer size, this can be used to achieve precise value if paired with the multiplier.

        config ESP_CAM_IO_PARL_FRAME_SIZE_PADDING
            int "JPEG frame buffer padding (bytes)"
            range 0 2519424
            default 4096
            help
                After the resulting value by the multiplier/divider, the padding bytes can reduce the JPEG buffer overflow warning on lower JPEG resolutions.
                If multiplier is set to 0, the resulting frame buffer size will be equal to the padding value.
    endif

    choice ESP_CAM_IO_PARL_SCCB_I2C_PORT
        bool "I2C peripheral to use for SCCB"
        default ESP_CAM_IO_PARL_SCCB_I2C_PORT0
        help
            Choose what I2C port to be used for SCCB. LP I2C is also supported, refer to the datasheet for each SoC LP I2C pins.

        config ESP_CAM_IO_PARL_SCCB_I2C_PORT0
            bool "I2C0"
        config ESP_CAM_IO_PARL_SCCB_I2C_PORT1
            bool "I2C1"
            depends on SOC_HP_I2C_NUM > 1
        config ESP_CAM_IO_PARL_SCCB_LP_I2C_PORT0
            bool "LP I2C0"
            depends on SOC_LP_I2C_SUPPORTED
    endchoice

    config ESP_CAM_IO_PARL_SCCB_CLK_FREQ
    int "SCCB clock frequency"
    default 100000
    range 100000 400000
    help
        Increasing this value can reduce the initialization time of the sensor.
        Please refer to the relevant instructions of the sensor to adjust the value.

    config ESP_CAM_IO_PARL_PAYLOAD_SIZE
        int "DMA buffer size"
        range 8192 65535
        default 32768
        help
            Maximum value of DMA payload buffer
            Larger values may fail to allocate due to insufficient contiguous memory blocks, and smaller value may cause DMA interrupt to be too frequent.
endmenu
```

## examples/camera_web_server_example/main/Kconfig.projbuild
```kconfig
menu "Example Configuration"

choice ESP_EXAMPLE_WIFI_MODE
    bool "Wi-Fi mode for web server"
    default ESP_EXAMPLE_WIFI_MODE_AP
    help
        Choose if the ESP32 target operates in Station (STA) mode, Access Point (AP), or GPIO controlled mode.

    config ESP_EXAMPLE_WIFI_MODE_STA
        bool "Station (STA)"
    config ESP_EXAMPLE_WIFI_MODE_AP
        bool "Access Point (AP)"
    config ESP_EXAMPLE_WIFI_MODE_GPIO
        bool "GPIO controlled STA/AP"
endchoice

config ESP_EXAMPLE_WIFI_GPIO
    int "Wi-Fi switching mode GPIO"
    depends on ESP_EXAMPLE_WIFI_MODE_GPIO
    default 0
    range 0 63
    help
        Choose what GPIO pin to act as a switch between Station and Access Point modes on start-up

choice ESP_EXAMPLE_WIFI_AP_BAND
    bool "Wi-Fi AP band"
    depends on ESP_EXAMPLE_WIFI_MODE_AP || ESP_EXAMPLE_WIFI_MODE_GPIO
    default ESP_EXAMPLE_WIFI_AP_BAND_2GHZ
    help
        Choose the AP band for the ESP32

    config ESP_EXAMPLE_WIFI_AP_BAND_2GHZ
        bool "2GHz"
    config ESP_EXAMPLE_WIFI_AP_BAND_5GHZ
        bool "5GHz"
        depends on SOC_WIFI_SUPPORT_5G
endchoice

config ESP_EXAMPLE_WIFI_SSID
    string "WiFi SSID"
    depends on ESP_EXAMPLE_WIFI_MODE_STA || ESP_EXAMPLE_WIFI_MODE_GPIO
    default "myssid"
    help
	    SSID (network name) for the example to connect to.

config ESP_EXAMPLE_WIFI_PASSWORD
    string "WiFi Password"
    depends on ESP_EXAMPLE_WIFI_MODE_STA || ESP_EXAMPLE_WIFI_MODE_GPIO
    default "mypassword"
    help
	    WiFi password (WPA or WPA2) for the example to use.

config ESP_EXAMPLE_WIFI_AP_SSID
    string "WiFi (AP) SSID"
    depends on ESP_EXAMPLE_WIFI_MODE_AP || ESP_EXAMPLE_WIFI_MODE_GPIO
    default "myssid"
    help
        SSID (network name) for the AP of the example.

config ESP_EXAMPLE_WIFI_AP_PASSWORD
    string "WiFi (AP) Password"
    depends on ESP_EXAMPLE_WIFI_MODE_AP || ESP_EXAMPLE_WIFI_MODE_GPIO
    default "mypassword"
    help
        WiFi password (WPA or WPA2) to use for the AP of the example.
endmenu
```

## examples/camera_web_server_example/sdkconfig.defaults
```kconfig
CONFIG_ESP_SYSTEM_EVENT_TASK_STACK_SIZE=4096

CONFIG_FREERTOS_HZ=1000

CONFIG_ESP_INT_WDT=n
CONFIG_ESP_TASK_WDT_EN=n

CONFIG_LWIP_IRAM_OPTIMIZATION=y
CONFIG_LWIP_TCPIP_TASK_PRIO=23

CONFIG_COMPILER_OPTIMIZATION_PERF=y

CONFIG_PARTITION_TABLE_SINGLE_APP_LARGE=y

CONFIG_ESP_CAM_IO_PARL_PAYLOAD_SIZE=16384
```
